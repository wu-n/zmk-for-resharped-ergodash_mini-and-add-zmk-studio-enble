## config/Kconfig
```kconfig
#
# Copyright (c) 2022 The ZMK Contributors
# SPDX-License-Identifier: MIT
#

config SHIELD_ERGODASH_MINI_CENTRAL_DONGLE
    bool

config BOARD_ERGODASH_MINI_CENTRAL_LEFT
    bool

confih BOARD_ERGODASH_MINI_PERIPHERAL_LEFT
    bool

config BOARD_ERGODASH_MINI_RIGHT
    bool
```

## config/west.yml
```yaml
manifest:
  remotes:
    - name: zmkfirmware
      url-base: https://github.com/zmkfirmware
  projects:
    - name: zmk
      remote: zmkfirmware
      revision: main
      import: app/west.yml
    - name: zmk-fingerpunch-keyboards
      remote: sadekbaroudi
      revision: main
      import: config/deps.yml
  self:
    path: config
```
